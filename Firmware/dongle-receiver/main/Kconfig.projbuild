## Firmware/dongle-receiver/main/Kconfig.projbuild
```kconfig
# SPDX-License-Identifier: MIT-only
# Copyright (c) 2026 ESP32-S3 Dongle. All rights reserved.
#
# menuconfig uzerinden yapilabilen proje ayarlari.
# Komut: idf.py menuconfig -> "ESP32-S3 Dongle" menusu.

menu "ESP32-S3 Dongle"

    menu "ESP-NOW RX (C6 baglanti)"
        config C6_PEER_MAC
            string "C6 gonderici MAC adresi (xx:xx:xx:xx:xx:xx)"
            default "AA:BB:CC:DD:EE:FF"
            help
                S3 bu MAC'den gelen paketleri kabul eder (MAC filtre).

        config ESPNOW_CHANNEL
            int "ESP-NOW Wi-Fi kanali (1-13)"
            default 6
            range 1 13
            help
                C6 ile ayni kanalda olmalidir.
    endmenu

    menu "Watchdog (C6 baglanti sagligi)"
        config C6_WATCHDOG_TIMEOUT_MS
            int "C6 baglanti kopma timeout (ms)"
            default 1000
            range 100 10000
            help
                Bu sure boyunca C6'dan paket gelmezse tum tuşlar birakilir (Bölüm 3).
    endmenu

    menu "USB HID (TinyUSB)"
        config USB_POLL_INTERVAL_MS
            int "USB poll interval (ms) - bInterval"
            default 1
            range 1 10
            help
                1 = 1000Hz. TinyUSB raporlama hizi.

        config USB_NKRO_MAX_KEYS
            int "NKRO maksimum eszamanli tuş sayisi"
            default 32
            range 6 64
    endmenu

    menu "Wi-Fi AP (CONFIG_AP_MODE)"
        config AP_SSID
            string "Wi-Fi AP SSID"
            default "S3-Dongle-Config"

        config AP_PASSWORD
            string "Wi-Fi AP sifre (bos = acik)"
            default ""

        config AP_CHANNEL
            int "Wi-Fi AP kanali"
            default 6
            range 1 13

        config AP_MAX_CONNECTIONS
            int "Maksimum AP istemci sayisi"
            default 1
            range 1 4
    endmenu

    menu "Hall Effect (Bölüm 4)"
        config HALL_HYSTERESIS
            float "Geleneksel mod histerezis degeri [0.0-1.0]"
            default 0.1
            help
                Tuş birakma eşiği = actuation_point - hysteresis.

        config HALL_RT_MIN_BOUNDARY
            float "RT minimum sinir [0.0-1.0]"
            default 0.0

        config HALL_RT_MAX_BOUNDARY
            float "RT maksimum sinir [0.0-1.0]"
            default 1.0
    endmenu

    menu "Packet Rate"
        config S3_LOOP_RATE_HZ
            int "Ana döngü hizi (Hz) - NORMAL_MODE"
            default 1000
            range 100 1000
            help
                1000 Hz = 1 kHz (C6 ile eszamanli, Bölüm 6).
    endmenu

endmenu
```

## Firmware/macropad-sender/main/Kconfig.projbuild
```kconfig
# SPDX-License-Identifier: MIT-only
# Copyright (c) 2026 ESP32-C6 Macropad. All rights reserved.
#
# menuconfig uzerinden yapilabilen proje ayarlari.
# Komut: idf.py menuconfig -> "ESP32-C6 Macropad" menusu.

menu "ESP32-C6 Macropad"

    menu "ESP-NOW / S3 Baglanti"
        config S3_PEER_MAC
            string "S3 alici MAC adresi (xx:xx:xx:xx:xx:xx formatinda)"
            default "AA:BB:CC:DD:EE:FF"
            help
                ESP-NOW paketlerinin gonderilecegi S3'un MAC adresi.
                NVS override destegi ileride eklenebilir; simdilik sabit.

        config ESPNOW_CHANNEL
            int "ESP-NOW Wi-Fi kanali (1-13)"
            default 6
            range 1 13
            help
                S3 ile ayni kanalda olmalidir.
    endmenu

    menu "Varsayilan Degerler (NVS ilk acilis)"
        config ACTIVE_POWER_MODE_DEFAULT
            int "Varsayilan guc modu (0=Dijital, 1=Hibrit, 2=Agresif)"
            default 1
            range 0 2

        config BASE_BRIGHTNESS_DEFAULT
            int "Varsayilan taban parlaklik (%)"
            default 60
            range 0 100

        config ACTIVE_LAYER_DEFAULT
            int "Varsayilan aktif katman"
            default 0
            range 0 4
    endmenu

    menu "Fail-Safe / Baglanti Sagligi"
        config ESPNOW_FAILSAFE_THRESHOLD
            int "Arama moduna gecis icin ardisik basarisiz paket sayisi"
            default 100
            range 1 1000
            help
                Bu sayiya ulasilinca sistem 1 Hz'e dusurur ve analog/LED
                MOSFET'lerini kapatir (Bölüm 2.2).
    endmenu

    menu "Hibrit Mod Inaktivite"
        config HYBRID_INACTIVITY_TIMEOUT_MS
            int "Hibrit mod inaktivite zaman asimi (ms)"
            default 900000
            range 10000 3600000
            help
                Varsayilan 900000 ms = 15 dakika (Bölüm 4.2).
    endmenu

    menu "Pil Olcumu"
        config BATTERY_MEASURE_PERIOD_MS
            int "Pil voltaj olcum periyodu (ms)"
            default 10000
            range 1000 60000
            help
                Varsayilan 10000 ms = 10 saniye (Bölüm 4.4).
    endmenu

    menu "Packet Rate"
        config PACKET_RATE_ACTIVE_HZ
            int "Aktif paket gonderim hizi (Hz) - Agresif/Hibrit aktif"
            default 1000
            range 100 1000
            help
                Varsayilan 1000 Hz = 1 kHz (Bölüm 4.2 / 4.3).

        config PACKET_RATE_SEARCH_HZ
            int "Arama modu (fail-safe) paket hizi (Hz)"
            default 1
            range 1 10
            help
                Baglanti koptugunda dusulen hiz (Bölüm 2.2).
    endmenu

    menu "Wakeup Polling"
        config WAKEUP_POLL_PERIOD_MS
            int "Encoder/SR buton polling periyodu (ms) - light sleep sirasinda"
            default 50
            range 10 500
            help
                Diot-OR sadece 12 dijital tusu OR'lar; encoder ve SW2/ENC_BTN
                SR uzerinden okundugu icin periyodik timer wake ile poll edilir.
    endmenu

endmenu
```

## examples/c6_ble_hid_lab/sdkconfig.defaults
```kconfig
CONFIG_BT_ENABLED=y
CONFIG_BT_NIMBLE_ENABLED=y
CONFIG_PARTITION_TABLE_SINGLE_APP_LARGE=y
CONFIG_ESPTOOLPY_FLASHSIZE_4MB=y
CONFIG_ESP_CONSOLE_USB_SERIAL_JTAG=y

CONFIG_BT_NIMBLE_HID_SERVICE=y
```

## examples/c6_s3_sensor_bridge/c6/main/Kconfig.projbuild
```kconfig
menu "Wireless HE experimental power policy"
    config WHE_POWER_GATE_EXPERIMENT
        bool "Enable experimental MOSFET idle duty cycling (GPIO23 / D5)"
        default n
        help
            Only for the XIAO test wiring with a verified active-low P-MOSFET.
            Idle: power rail in short pulses and sample at 100 Hz.
            Press detected: rail remains on, target 1 kHz until released for 2 s.
            Requires removing any direct connection between VCC_ANALOG and 3V3.
            Test current, settling, wake threshold and partial power/backfeed.
    config WHE_SENSOR_STARTUP_US
        int "Rail power-on wait (microseconds)"
        range 330 5000
        default 600
        depends on WHE_POWER_GATE_EXPERIMENT
    config WHE_WAKE_DELTA_ADC
        int "Wake threshold above idle baseline (raw ADC counts)"
        range 2 1000
        default 20
    config WHE_RELEASE_DELTA_ADC
        int "Release threshold above idle baseline (raw ADC counts)"
        range 0 999
        default 17
endmenu
```

## examples/c6_s3_sensor_bridge/s3/sdkconfig.defaults
```kconfig
CONFIG_ESP_CONSOLE_USB_SERIAL_JTAG=y
CONFIG_ESPTOOLPY_FLASHSIZE_8MB=y
CONFIG_FREERTOS_HZ=1000
```

## examples/c6_s3_sensor_bridge/s3_composite/sdkconfig.defaults
```kconfig
CONFIG_ESP_CONSOLE_USB_SERIAL_JTAG=y
CONFIG_ESPTOOLPY_FLASHSIZE_8MB=y
CONFIG_FREERTOS_HZ=1000
CONFIG_TINYUSB_CDC_ENABLED=y
CONFIG_TINYUSB_CDC_COUNT=1
CONFIG_TINYUSB_CDC_TX_BUFSIZE=1024
CONFIG_TINYUSB_HID_COUNT=1
```

## examples/lighting_espnow_lab/dongle_s3/main/Kconfig.projbuild
```kconfig
menu "Lighting Lab"
config LAB_PEER_MAC
    string "Peer station MAC address (AA:BB:CC:DD:EE:FF)"
    default ""
    help
        Enter the other board's Wi-Fi station MAC. Empty means radio disabled.
config LAB_WIFI_CHANNEL
    int "ESP-NOW channel"
    range 1 13
    default 1
endmenu
```

## examples/lighting_espnow_lab/keyboard_c6/main/Kconfig.projbuild
```kconfig
menu "Lighting Lab"
config LAB_PEER_MAC
    string "Peer station MAC address (AA:BB:CC:DD:EE:FF)"
    default ""
    help
        Enter the other board's Wi-Fi station MAC. Empty means radio disabled.
config LAB_WIFI_CHANNEL
    int "ESP-NOW channel"
    range 1 13
    default 1
endmenu
menu "Lighting Lab C6 hardware"
config LAB_LED_OUTPUT
    bool "Enable SK6812 output (verify wiring before enabling)"
    default n
config LAB_LED_GPIO
    int "SK6812 data GPIO"
    range 0 30
    default 5
config LAB_BOOST_CONTROL
    bool "Drive LED boost enable GPIO (verify circuit first)"
    default n
config LAB_BOOST_GPIO
    int "LED boost enable GPIO"
    range 0 30
    default 14
config LAB_BOOST_ACTIVE_LEVEL
    int "LED boost enable active level"
    range 0 1
    default 1
endmenu
menu "Lighting Lab analog inputs"
config LAB_ANALOG_INPUT
    bool "Read MCP3202 and CD74HC4067 (verify wiring first)"
    default n
config LAB_ADC_CHANNEL
    int "MCP3202 channel (0 or 1; check schematic)"
    range 0 1
    default 0
config LAB_ADC_SCK
    int "ADC SCK GPIO"
    range 0 30
    default 6
config LAB_ADC_MISO
    int "ADC MISO GPIO"
    range 0 30
    default 2
config LAB_ADC_MOSI
    int "ADC MOSI GPIO"
    range 0 30
    default 3
config LAB_ADC_CS
    int "ADC CS GPIO"
    range 0 30
    default 7
config LAB_MUX_S0
    int "MUX S0 GPIO"
    range 0 30
    default 18
config LAB_MUX_S1
    int "MUX S1 GPIO"
    range 0 30
    default 19
config LAB_MUX_S2
    int "MUX S2 GPIO"
    range 0 30
    default 20
config LAB_MUX_S3
    int "MUX S3 GPIO"
    range 0 30
    default 15
config LAB_ANALOG_POWER_CONTROL
    bool "Drive analog power-enable GPIO (verify circuit first)"
    default n
config LAB_ANALOG_POWER_GPIO
    int "Analog power-enable GPIO"
    range 0 30
    default 21
config LAB_ANALOG_POWER_LEVEL
    int "Analog power-enable active level"
    range 0 1
    default 1
endmenu
```
